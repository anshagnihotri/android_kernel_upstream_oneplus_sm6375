## device/oneplus/larry/drivers/oplus/Kconfig
```kconfig
source "device/oneplus/larry/drivers/oplus/power/oplus/Kconfig"
source "device/oneplus/larry/drivers/oplus/kernel/touchpanel/oplus_touchscreen_v2/Kconfig"
```

## device/oneplus/larry/drivers/oplus/kernel/misc/Kconfig
```kconfig
# SPDX-License-Identifier: GPL-2.0-only
# Copyright (C) 2018-2020 Oplus. All rights reserved.

#ifdef OPLUS_FEATURE_ESIM
source "device/oneplus/larry/drivers/oplus/kernel/misc/oplus_gpio/Kconfig"
#endif /* OPLUS_FEATURE_ESIM */
```

## device/oneplus/larry/drivers/oplus/kernel/system/Kconfig
```kconfig
# SPDX-License-Identifier: GPL-2.0-only
# Copyright (C) 2018-2020 Oplus. All rights reserved.
config OPLUS_SYSTEM_KERNEL
  bool "config oplus system feature "
  default y
  help
	define this config to add oplus sytstem kernel feature

config OPLUS_ARCH_FILE
  bool "for build directory oplus"
  help
	say Y to buid in

config OPLUS_COMMON_SOFT
  bool "config oplus common software"
  select OPLUS_ARCH_FILE
  help
	define this config to get project verion from sharemem.
	Maybe this value is from CDT or dynamic identify by hardware
	id.
		.
config OPLUS_BUG_STABILITY_EFFECTON_QGKI
  tristate "config stability bug fixing effect on qgki"
  help
	define this config to fix stability bug only effect on qgki

config OPLUS_FEATURE_DETAILHEAD
  tristate "config detail kmsg"
    help
        define this config to add cpu number and current id and current comm to kmsg

source "device/oneplus/larry/drivers/oplus/kernel/system/feedback/Kconfig"
source "device/oneplus/larry/drivers/oplus/kernel/system/uboot_log/Kconfig"
source "device/oneplus/larry/drivers/oplus/kernel/system/shutdown_detect/Kconfig"
source "device/oneplus/larry/drivers/oplus/kernel/system/slabtrace/Kconfig"
source "device/oneplus/larry/drivers/oplus/kernel/system/oplus_project/Kconfig"
source "device/oneplus/larry/drivers/oplus/kernel/system/qcom_minidump/Kconfig"
source "device/oneplus/larry/drivers/oplus/kernel/system/hung_task_enhance/Kconfig"
source "device/oneplus/larry/drivers/oplus/kernel/system/oplus_phoenix/Kconfig"
source "device/oneplus/larry/drivers/oplus/kernel/system/oplus_pmic_monitor/Kconfig"
source "device/oneplus/larry/drivers/oplus/kernel/system/oplus_pmic_monitor_mtk/Kconfig"
source "device/oneplus/larry/drivers/oplus/kernel/system/oplus_saupwk/Kconfig"
source "device/oneplus/larry/drivers/oplus/kernel/system/project_info/Kconfig"
source "device/oneplus/larry/drivers/oplus/kernel/system/cmdline_parser/Kconfig"
source "device/oneplus/larry/drivers/oplus/kernel/system/dump_device_info/Kconfig"
source "device/oneplus/larry/drivers/oplus/kernel/system/mdmrst/Kconfig"
source "device/oneplus/larry/drivers/oplus/kernel/system/full_aging/Kconfig"
#ifdef OPLUS_FEATURE_QCOM_PMICWD
source "device/oneplus/larry/drivers/oplus/kernel/system/qcom_pmicwd/Kconfig"
#endif /* OPLUS_FEATURE_QCOM_PMICWD */

#ifdef OPLUS_FEATURE_MM_OSVELTE
source "device/oneplus/larry/drivers/oplus/kernel/system/mm_osvelte/Kconfig"
#endif /* OPLUS_FEATURE_MM_OSVELTE */

#ifdef OPLUS_FEATURE_DUMP_REASON
source "device/oneplus/larry/drivers/oplus/kernel/system/dump_reason/Kconfig"
#endif /* OPLUS_FEATURE_DUMP_REASON */

#ifdef OPLUS_FEATURE_MM_FEEDBACK
source "device/oneplus/larry/drivers/oplus/kernel/system/oplus_mm_fb/Kconfig"
#endif /* OPLUS_FEATURE_MM_FEEDBACK */

#ifdef OPLUS_FEATURE_QCOM_WATCHDOG
source "device/oneplus/larry/drivers/oplus/kernel/system/qcom_watchdog/Kconfig"
#endif /* OPLUS_FEATURE_QCOM_WATCHDOG */

#ifdef OPLUS_FEATURE_ACM
source "device/oneplus/larry/drivers/oplus/kernel/system/acm/Kconfig"
#endif /* OPLUS_FEATURE_ACM */
#ifdef OPLUS_FEATURE_THEIA
source "device/oneplus/larry/drivers/oplus/kernel/system/theia/Kconfig"
#endif /* OPLUS_FEATURE_THEIA */
#ifdef OPLUS_FEATURE_SELINUX_CONTROL_LOG
source "device/oneplus/larry/drivers/oplus/kernel/system/selinux/Kconfig"
#endif /* OPLUS_FEATURE_SELINUX_CONTROL_LOG */
#ifdef OPLUS_FEATURE_MISC
source "device/oneplus/larry/drivers/oplus/kernel/system/misc/Kconfig"
#endif /* OPLUS_FEATURE_MISC */

#ifdef OPLUS_FEATURE_FORCE_SHUTDOWN
source "device/oneplus/larry/drivers/oplus/kernel/system/mtk_shutdown_reboot/Kconfig"
#endif

#ifdef OPLUS_FEATURE_RT_OPT_INFO
source "device/oneplus/larry/drivers/oplus/kernel/system/rt_info/Kconfig"
#endif
#ifdef OPLUS_FEATURE_HANS
source "device/oneplus/larry/drivers/oplus/kernel/system/oplus_hans/Kconfig"
#endif /* OPLUS_FEATURE_HANS */
```

## device/oneplus/larry/drivers/oplus/kernel/touchpanel/oplus_touchscreen_v2/Focal/Kconfig
```kconfig
source "device/oneplus/larry/drivers/oplus/kernel/touchpanel/oplus_touchscreen_v2/Focal/ft3518/Kconfig"
source "device/oneplus/larry/drivers/oplus/kernel/touchpanel/oplus_touchscreen_v2/Focal/ft3658u/Kconfig"
source "device/oneplus/larry/drivers/oplus/kernel/touchpanel/oplus_touchscreen_v2/Focal/ft3681/Kconfig"
```

## device/oneplus/larry/drivers/oplus/kernel/touchpanel/oplus_touchscreen_v2/Goodix/Kconfig
```kconfig
source "device/oneplus/larry/drivers/oplus/kernel/touchpanel/oplus_touchscreen_v2/Goodix/GT9886/Kconfig"
```

## device/oneplus/larry/drivers/oplus/kernel/touchpanel/oplus_touchscreen_v2/Himax/Kconfig
```kconfig
#source "device/oneplus/larry/drivers/oplus/kernel/touchpanel/oplus_touchscreen_v2/Himax/hx83112b/Kconfig"
source "device/oneplus/larry/drivers/oplus/kernel/touchpanel/oplus_touchscreen_v2/Himax/hx83112a_noflash/Kconfig"
#source "device/oneplus/larry/drivers/oplus/kernel/touchpanel/oplus_touchscreen_v2/Himax/hx83112b_noflash/Kconfig"
source "device/oneplus/larry/drivers/oplus/kernel/touchpanel/oplus_touchscreen_v2/Himax/hx83102j_noflash/Kconfig"
```

## device/oneplus/larry/drivers/oplus/kernel/touchpanel/oplus_touchscreen_v2/Novatek/Kconfig
```kconfig
source "device/oneplus/larry/drivers/oplus/kernel/touchpanel/oplus_touchscreen_v2/Novatek/NT36672C_noflash/Kconfig"
```

## device/oneplus/larry/drivers/oplus/kernel/touchpanel/oplus_touchscreen_v2/Samsung/Kconfig
```kconfig
source "device/oneplus/larry/drivers/oplus/kernel/touchpanel/oplus_touchscreen_v2/Samsung/S6SY791/Kconfig"
source "device/oneplus/larry/drivers/oplus/kernel/touchpanel/oplus_touchscreen_v2/Samsung/S6SY792/Kconfig"
```

## device/oneplus/larry/drivers/oplus/kernel/touchpanel/oplus_touchscreen_v2/St/Kconfig
```kconfig
source "device/oneplus/larry/drivers/oplus/kernel/touchpanel/oplus_touchscreen_v2/St/ST80Y/Kconfig"
```

## device/oneplus/larry/drivers/oplus/kernel/touchpanel/oplus_touchscreen_v2/ilitek/Kconfig
```kconfig
source "device/oneplus/larry/drivers/oplus/kernel/touchpanel/oplus_touchscreen_v2/ilitek/ilitek9881h/Kconfig"
source "device/oneplus/larry/drivers/oplus/kernel/touchpanel/oplus_touchscreen_v2/ilitek/ilitek7807s/Kconfig"
```
